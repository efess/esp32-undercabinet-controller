## main/Kconfig.projbuild
```kconfig
menu "CABINET_LIGHTING Configuration"
    orsource "$IDF_PATH/examples/common_components/env_caps/$IDF_TARGET/Kconfig.env_caps"

    config CABINET_LIGHTING_GPIO_MIC_CLK
        int "GPIO input Mic Serial Clk"
        range ENV_GPIO_RANGE_MIN ENV_GPIO_IN_RANGE_MAX
        default 4
        help
            GPIO pin number to be used as I2S Serial Clock.

    config CABINET_LIGHTING_GPIO_MIC_SD
        int "GPIO input Mic Serial Data"
        range ENV_GPIO_RANGE_MIN ENV_GPIO_IN_RANGE_MAX
        default 4
        help
            GPIO pin number to be used as I2S Serial Data

    config CABINET_LIGHTING_GPIO_MIC_WS
        int "GPIO input Mic Left/Right clock (Word Select)"
        range ENV_GPIO_RANGE_MIN ENV_GPIO_IN_RANGE_MAX
        default 4
        help
            GPIO pin number to be used as I2S Word Select

    config CABINET_LIGHTING_GPIO_MOTION_SENSOR
        int "GPIO input Motion Sensor"
        range ENV_GPIO_RANGE_MIN ENV_GPIO_IN_RANGE_MAX
        default 4
        help
            GPIO pin number to be used as GPIO_MOTION_SENSOR.

    config CABINET_LIGHTING_LED_SIGNAL
        int "GPIO output pin 1"
        range ENV_GPIO_RANGE_MIN ENV_GPIO_IN_RANGE_MAX
        default 7
        help
            GPIO pin number to be used as GPIO_DOOR_SIGNAL_1.
        
    config CABINET_LIGHTING_MDNS_HOST_NAME
        string "mDNS Host Name"
        default "esp-home"
        help
            Specify the domain name used in the mDNS service.
            Note that webpage also take it as a part of URL where it will send GET/POST requests to.

    choice CABINET_LIGHTING_WEB_DEPLOY_MODE
        prompt "Website deploy mode"
        default CABINET_LIGHTING_WEB_DEPLOY_SEMIHOST
        help
            Select website deploy mode.
            You can deploy website to host, and ESP32 will retrieve them in a semihost way (JTAG is needed).
            You can deploy website to SD card or SPI flash, and ESP32 will retrieve them via SDIO/SPI interface.
            Detailed operation steps are listed in the example README file.
        config CABINET_LIGHTING_WEB_DEPLOY_SEMIHOST
            bool "Deploy website to host (JTAG is needed)"
            help
                Deploy website to host.
                It is recommended to choose this mode during developing.
        config CABINET_LIGHTING_WEB_DEPLOY_SD
            depends on IDF_TARGET_ESP32
            bool "Deploy website to SD card"
            help
                Deploy website to SD card.
                Choose this production mode if the size of website is too large (bigger than 2MB).
        config CABINET_LIGHTING_WEB_DEPLOY_SF
            bool "Deploy website to SPI Nor Flash"
            help
                Deploy website to SPI Nor Flash.
                Choose this production mode if the size of website is small (less than 2MB).
    endchoice

    if CABINET_LIGHTING_WEB_DEPLOY_SEMIHOST
        config CABINET_LIGHTING_HOST_PATH_TO_MOUNT
            string "Host path to mount (e.g. absolute path to web dist directory)"
            default "PATH-TO-WEB-DIST_DIR"
            help
                When using semihost in ESP32, you should specify the host path which will be mounted to VFS.
                Note that only absolute path is acceptable.
    endif

    config CABINET_LIGHTING_WEB_MOUNT_POINT
        string "Website mount point in VFS"
        default "/www"
        help
            Specify the mount point in VFS.

    config CABINET_LIGHTING_WIFI_STATION_NAME
        string "Name of wifi station when in AP mode"
        default "undercabinet-esp32-controller"
        help
            This is the name of the device that will show up in wifi scans.

    choice CABINET_LIGHTING_WIFI_SCAN_METHOD
        prompt "WiFi Scan Method"
        default CABINET_LIGHTING_WIFI_SCAN_METHOD_ALL_CHANNEL
        help
            WiFi scan method:

            If "Fast" is selected, scan will end after find SSID match AP.

            If "All Channel" is selected, scan will end after scan all the channel.

        config CABINET_LIGHTING_WIFI_SCAN_METHOD_FAST
            bool "Fast"
        config CABINET_LIGHTING_WIFI_SCAN_METHOD_ALL_CHANNEL
            bool "All Channel"
    endchoice

    choice CABINET_LIGHTING_WIFI_CONNECT_AP_SORT_METHOD
        prompt "WiFi Connect AP Sort Method"
        default CABINET_LIGHTING_WIFI_CONNECT_AP_BY_SIGNAL
        help
            WiFi connect AP sort method:

            If "Signal" is selected, Sort matched APs in scan list by RSSI.

            If "Security" is selected, Sort matched APs in scan list by security mode.

        config CABINET_LIGHTING_WIFI_CONNECT_AP_BY_SIGNAL
            bool "Signal"
        config CABINET_LIGHTING_WIFI_CONNECT_AP_BY_SECURITY
            bool "Security"
    endchoice
endmenu
```
